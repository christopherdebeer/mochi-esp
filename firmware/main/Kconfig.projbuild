## firmware/main/Kconfig.projbuild
```kconfig
menu "Mochi power management"

config MOCHI_DOZE_TIMEOUT_S
    int "Idle seconds before entering the Doze tier"
    default 60
    help
        Seconds with no touch/button before the device drops from Live to
        the Doze resting tier (WiFi power-save, stretched refresh, and —
        if MOCHI_LIGHT_SLEEP is set — automatic light sleep). 0 disables
        Doze entirely (always Live), which still records a clean Live
        power baseline through the power telemetry.

config MOCHI_DEEP_SLEEP_TIMEOUT_S
    int "Idle seconds in Doze before automatic deep sleep (0 = never)"
    default 0
    help
        Secondary timeout: continuous seconds spent dozing before the
        device commits to deep sleep to protect the battery. 0 leaves
        deep sleep as an explicit PWR-tap action only.

config MOCHI_DOZE_WIFI_POWERSAVE
    bool "Use WIFI_PS_MAX_MODEM while dozing"
    default y
    help
        Switch WiFi to maximum modem-sleep on Doze entry and back to
        min-modem (the IDF default) on wake. Safe and reversible; yields
        a real saving even without MOCHI_LIGHT_SLEEP.

config MOCHI_LIGHT_SLEEP
    bool "Enable automatic light sleep while dozing"
    default n
    select PM_ENABLE
    select FREERTOS_USE_TICKLESS_IDLE
    help
        While dozing, let the SoC enter automatic light sleep (esp_pm)
        between events. RAM and the e-paper image are retained; a touch
        (GPIO21 INT) or button wakes it in microseconds — unlike deep
        sleep, which reboots. Default OFF pending on-hardware validation
        (touch-INT wake on this board rev, WiFi/TLS coexistence, and the
        USB-Serial-JTAG console blocking light sleep on the bench). The
        power telemetry and tier accounting run regardless of this flag.

config MOCHI_PM_CPU_MAX_MHZ
    int "Max CPU frequency (MHz) under light sleep"
    depends on MOCHI_LIGHT_SLEEP
    default 240

config MOCHI_PM_CPU_MIN_MHZ
    int "Min CPU frequency (MHz) under light sleep"
    depends on MOCHI_LIGHT_SLEEP
    default 80

endmenu
```

## firmware/sdkconfig.defaults
```kconfig
# sdkconfig defaults for eink-pet.
#
# This file is the source of truth for project config. The `sdkconfig`
# file that ESP-IDF generates on first build is NOT committed — delete
# it and rebuild if you need to regenerate from these defaults.
#
# Documented changes here should be small and named; large reconfigs
# belong in a successor `sdkconfig.defaults.<feature>` overlay.

# Target chip
CONFIG_IDF_TARGET="esp32s3"

# 8MB flash, octal PSRAM (N8R8 variant)
CONFIG_ESPTOOLPY_FLASHSIZE_8MB=y
CONFIG_ESPTOOLPY_FLASHSIZE="8MB"
CONFIG_SPIRAM=y
CONFIG_SPIRAM_MODE_OCT=y
CONFIG_SPIRAM_SPEED_80M=y

# Custom partition table (see partitions.csv)
CONFIG_PARTITION_TABLE_CUSTOM=y
CONFIG_PARTITION_TABLE_CUSTOM_FILENAME="partitions.csv"
CONFIG_PARTITION_TABLE_FILENAME="partitions.csv"

# Console over USB CDC (no external USB-to-serial chip; the ESP32-S3 has
# native USB). UART0 console is disabled so all output goes to USB.
CONFIG_ESP_CONSOLE_USB_SERIAL_JTAG=y
CONFIG_ESP_CONSOLE_SECONDARY_NONE=y

# 100Hz tick (the IDF default). design/26: the first doze-enabled
# release (v0.2.0) ran at 1000Hz and the telemetry showed ~no battery
# saving despite ~98% doze-tier residency — a 1kHz tick wakes the SoC
# up to 1000x/s, capping real light-sleep residency. Dropped to 100Hz
# (10ms granularity, still ample for our 100ms+ delays) so light sleep
# can actually accumulate. The 1kHz "for animation pacing later" never
# had a consumer.
CONFIG_FREERTOS_HZ=100

# Run-time stats: lets power.cpp read the idle-task run-time counter to
# report ACTUAL light-sleep residency (sleep_pct) in the power
# telemetry — the ground truth the tier counter can't give. esp_timer
# source (default) keeps counting through light sleep. design/26.
CONFIG_FREERTOS_GENERATE_RUN_TIME_STATS=y

# Power management (design/26). Automatic light sleep while the device
# is dozing (idle): the SoC sleeps between events with RAM + the e-paper
# image retained, waking on the touch INT (GPIO21) or a button in
# microseconds — no reboot, unlike deep sleep. MOCHI_LIGHT_SLEEP selects
# PM_ENABLE + tickless idle. Doze/deep-sleep timeouts + WiFi power-save
# live in main/Kconfig.projbuild.
CONFIG_MOCHI_LIGHT_SLEEP=y

# Compiler optimisation: -Og while we're in bring-up so backtraces are
# meaningful. Flip to -O2 once peripherals are stable.
CONFIG_COMPILER_OPTIMIZATION_DEBUG=y

# Log level: info during bring-up. Will tighten to warn for release.
CONFIG_LOG_DEFAULT_LEVEL_INFO=y

# HTTPS root cert bundle — built-in Mozilla bundle covers Let's
# Encrypt + every major commercial CA, which is what mochi.val.run
# (and any reasonable val.town deployment) chains to. Saves us from
# embedding individual CA PEMs and tracking renewals manually.
# Required for esp_http_client over TLS in M4+.
CONFIG_MBEDTLS_CERTIFICATE_BUNDLE=y
CONFIG_MBEDTLS_CERTIFICATE_BUNDLE_DEFAULT_FULL=y

# Main-task stack size. Default is 3584 B which is too small for
# inline TLS handshakes from app_main — mbedtls_mpi_grow during cert
# verification overflows it (M5 pair-init crashed here on first
# boot). 8 KB is comfortable for any HTTPS work app_main wants to
# do at boot before delegating to worker tasks.
CONFIG_ESP_MAIN_TASK_STACK_SIZE=8192

# DTLS-SRTP for esp_peer (M9). WebRTC requires SRTP for media-plane
# encryption; on the device side it negotiates over a DTLS handshake.
# Default ESP-IDF mbedTLS config doesn't enable DTLS or SRTP, which
# breaks esp_peer's dtls_common.h (mbedtls_ssl_srtp_profile etc.
# undefined). Turning these on is mandatory for any WebRTC path.
# DTLS_SRTP depends on PROTO_DTLS, so both must be set.
CONFIG_MBEDTLS_SSL_PROTO_DTLS=y
CONFIG_MBEDTLS_SSL_DTLS_SRTP=y

# OTA — over-the-air firmware updates from GitHub Releases (M14).
#
# Rollback: if a freshly-installed image fails to call
# esp_ota_mark_app_valid_cancel_rollback() before the next reset
# (e.g. it crashes during boot, or we lose power before the
# WiFi+OTA-mark path completes), the bootloader auto-falls back to
# the previous slot. ota_update::mark_valid_if_pending() is wired
# into main right after WiFi STA joins, which is the earliest point
# we have evidence the new image is healthy enough to keep.
CONFIG_BOOTLOADER_APP_ROLLBACK_ENABLE=y
```
